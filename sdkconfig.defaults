## sdkconfig.defaults
```kconfig
# StampFly HAL ESP-IDF Configuration Defaults
# ESP32-S3 Optimized Settings for StampFly Hardware

# Target Configuration
CONFIG_IDF_TARGET="esp32s3"

# Flash Configuration
CONFIG_ESPTOOLPY_FLASHSIZE_8MB=y
# PSRAM is not available on StampFly hardware (M5Stamp S3)
# CONFIG_ESP32S3_SPIRAM_SUPPORT=n

# CPU and Memory Configuration  
CONFIG_ESP32S3_DEFAULT_CPU_FREQ_240=y
CONFIG_ESP_MAIN_TASK_STACK_SIZE=8192

# FreeRTOS Configuration (400Hz control loop support)
CONFIG_FREERTOS_HZ=1000
CONFIG_FREERTOS_USE_TRACE_FACILITY=y
CONFIG_FREERTOS_GENERATE_RUN_TIME_STATS=y

# Flash Configuration
CONFIG_PARTITION_TABLE_CUSTOM=y
CONFIG_PARTITION_TABLE_CUSTOM_FILENAME="partitions.csv"

# Console and Logging Configuration
# USB-CDC Console Configuration for ESP32-S3
CONFIG_ESP_CONSOLE_USB_CDC=y
CONFIG_ESP_CONSOLE_SECONDARY_NONE=y
CONFIG_ESP_CONSOLE_USB_CDC_RX_BUF_SIZE=256
CONFIG_ESP_CONSOLE_USB_CDC_TX_BUF_SIZE=256
CONFIG_LOG_DEFAULT_LEVEL_INFO=y
CONFIG_LOG_MAXIMUM_LEVEL_VERBOSE=y

# USB Configuration for ESP32-S3
CONFIG_TINYUSB=y
CONFIG_TINYUSB_CDC_ENABLED=y
CONFIG_TINYUSB_CDC_RX_BUFSIZE=256
CONFIG_TINYUSB_CDC_TX_BUFSIZE=256
CONFIG_TINYUSB_DESC_USE_ESPRESSIF_VID=y
CONFIG_TINYUSB_DESC_CDC_STRING="StampFly HAL USB Serial"
CONFIG_TINYUSB_DESC_MANUFACTURER_STRING="StampFly"
CONFIG_TINYUSB_DESC_PRODUCT_STRING="StampFly HAL Device"

# USB-OTG Configuration
CONFIG_USB_OTG_SUPPORTED=y

# Disable UART Console (use USB-CDC only)
CONFIG_ESP_CONSOLE_UART=n

# Driver Configuration
CONFIG_SPI_MASTER_IN_IRAM=y
CONFIG_SPI_MASTER_ISR_IN_IRAM=y

# Component Configuration
CONFIG_ESP_TIMER_TASK_STACK_SIZE=4096

# Compiler Optimization
CONFIG_COMPILER_OPTIMIZATION_SIZE=y
CONFIG_COMPILER_CXX_EXCEPTIONS=y
CONFIG_COMPILER_CXX_RTTI=y

# Hardware Specific (StampFly)
# GPIO Matrix and pin configurations will be set in code
# SPI: MISO=43, MOSI=14, SCLK=44
# I2C: SDA=3, SCL=4

# Security (disable for development)
CONFIG_SECURE_BOOT=n
CONFIG_SECURE_FLASH_ENC_ENABLED=n
```
